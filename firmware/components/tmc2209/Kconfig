## firmware/components/tmc2209/Kconfig
```kconfig
menu "Sower TMC2209 drivers"

    config SOWER_TMC2209_ENABLE
        bool "Configure TMC2209 stepper drivers over UART"
        default n
        help
            Включает инициализацию TMC2209 по UART2 (GPIO16/17 на MKS TinyBee).

            На плате по умолчанию драйверы часто в standalone-режиме (DIP/потенциометр).
            Для UART нужна разводка MS3/UART на общую линию UART2; см. docs и MKS issue #6.

    config SOWER_TMC2209_UART_PORT
        int "UART port number"
        depends on SOWER_TMC2209_ENABLE
        default 2
        range 0 2

    config SOWER_TMC2209_TX_GPIO
        int "UART TX GPIO"
        depends on SOWER_TMC2209_ENABLE
        default 17

    config SOWER_TMC2209_RX_GPIO
        int "UART RX GPIO"
        depends on SOWER_TMC2209_ENABLE
        default 16

    config SOWER_TMC2209_BAUD
        int "UART baud rate"
        depends on SOWER_TMC2209_ENABLE
        default 115200

    config SOWER_TMC2209_RSENSE_MILLIOHM
        int "Sense resistor value, milliohm"
        depends on SOWER_TMC2209_ENABLE
        default 110
        range 50 200
        help
            Типично 110 mOhm на модулях BIGTREETECH / MKS.

    config SOWER_TMC2209_RUN_CURRENT_MA
        int "Motor run current (RMS), mA"
        depends on SOWER_TMC2209_ENABLE
        default 1500
        range 200 2000

    config SOWER_TMC2209_MICROSTEPS
        int "Microsteps"
        depends on SOWER_TMC2209_ENABLE
        default 16
        help
            Допустимые значения: 1, 2, 4, 8, 16, 32, 64, 128, 256.

    config SOWER_TMC2209_STEALTHCHOP
        bool "Enable StealthChop (quiet mode)"
        depends on SOWER_TMC2209_ENABLE
        default y

    config SOWER_TMC2209_FAIL_ON_COMM_ERROR
        bool "Enter safe state if driver UART check fails"
        depends on SOWER_TMC2209_ENABLE
        default y

endmenu
```

## firmware/main/Kconfig.projbuild
```kconfig
menu "Sower bring-up options"

    config SOWER_OUTPUT_LED_TEST
        bool "Run TinyBee HE/FAN output LED test on boot"
        default n
        help
            Включает циклический тест I2SO-выходов H-BED, H-E0, H-E1,
            FAN1 и FAN2 сразу после старта прошивки.

            Использовать только для bring-up платы без подключенных
            нагревателей, клапанов, насосов и других силовых нагрузок.

    config SOWER_IO_MONITOR
        bool "Print TinyBee input and vacuum ADC monitor"
        default n
        help
            Включает периодический вывод stable/raw состояний входов
            и raw ADC вакуума в serial log.

            Использовать для проверки полярности датчиков и первичного
            bring-up входов. В production-режиме оставлять выключенным.

    config SOWER_IO_MONITOR_PERIOD_MS
        int "TinyBee input and ADC monitor period, ms"
        depends on SOWER_IO_MONITOR
        default 1000
        range 100 10000
        help
            Период вывода service-монитора входов и ADC в миллисекундах.

    config SOWER_CONVEYOR_MOTION_TEST
        bool "Run TinyBee conveyor X stepper motion test on boot"
        default n
        help
            Включает короткий тест X STEP/DIR/EN через I2SO: ось конвейера
            двигается вперед и назад после старта прошивки.

            Использовать только без опасной нагрузки или с подготовленной
            механикой, где движение конвейера безопасно.

    config SOWER_CONVEYOR_MOTION_TEST_DISTANCE_MM
        int "Conveyor motion test distance, mm"
        depends on SOWER_CONVEYOR_MOTION_TEST
        default 10
        range 1 200
        help
            Расстояние одного хода для теста конвейера в миллиметрах.

    config SOWER_CONVEYOR_MOTION_TEST_SPEED_MM_S
        int "Conveyor motion test speed, mm/s"
        depends on SOWER_CONVEYOR_MOTION_TEST
        default 5
        range 1 50
        help
            Скорость теста конвейера в миллиметрах в секунду.

endmenu
```

## sdkconfig.defaults
```kconfig
CONFIG_IDF_TARGET="esp32"
CONFIG_FREERTOS_HZ=1000
CONFIG_ESP_TASK_WDT_EN=y
CONFIG_ESP_TASK_WDT_TIMEOUT_S=5
CONFIG_ESP_MAIN_TASK_STACK_SIZE=8192
CONFIG_ESPTOOLPY_FLASHSIZE_8MB=y
CONFIG_ESPTOOLPY_FLASHSIZE="8MB"
CONFIG_PARTITION_TABLE_CUSTOM=y
CONFIG_PARTITION_TABLE_CUSTOM_FILENAME="partitions.csv"
```
